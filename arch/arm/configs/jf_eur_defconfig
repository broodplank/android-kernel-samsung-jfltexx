## arch/arm/configs/jf_eur_defconfig
```kconfig
CONFIG_MACH_JF_EUR=y
CONFIG_EXTRA_FIRMWARE="audience-es325-fw-eur.bin"
CONFIG_EXTRA_FIRMWARE_DIR="firmware"
CONFIG_LOCALVERSION="-broodKernel-Google-Edition-v1.0"
# CONFIG_LOCALVERSION_AUTO is not set
```
